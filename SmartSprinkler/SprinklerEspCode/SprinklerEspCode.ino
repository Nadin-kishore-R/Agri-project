// this is only for esp8266,for any other modules please change the libraries accordingly
#include <ESP8266WebServer.h>
#include <ESP8266WiFi.h>
#include <ElegantOTA.h>
#include <Firebase_ESP_Client.h>

#include <EEPROM.h>
#include <addons/RTDBHelper.h>
#include <addons/TokenHelper.h>

// ================= WIFI =================
#define WIFI_SSID "wifi_name"
#define WIFI_PASS "wifi_password"

// ================= FIREBASE =================
#define API_KEY "yyyyyyyyyyyyyyyyyyyyyyyyyy"
#define DATABASE_URL "xxxxxxxxxxxxxxxxxxxxxxxxxxxxxx"

#define USER_EMAIL "farmer1@gmail.com" // for example
#define USER_PASSWORD "123456"         // for example

// CHANGE THIS ID TO MATCH THE ONE GENERATED BY THE DASHBOARD!
#define SPRINKLER_ID "Sprinkler-1"

FirebaseData fbdo;
FirebaseData stream;
FirebaseAuth auth;
FirebaseConfig config;

String uid;
String configPath;
String sprinklerPath;

bool isFirebaseConnected = false;

ESP8266WebServer server(80);

// Pins
#define FLOW_PIN 14
#define MOISTURE_PIN A0
#define CLEAN_VALVE 12
// #define MOTOR_PIN 13

float radius = 4.0;
float targetMoisture = 500.0;
float rootDepth = 35.0;
float fieldCapacity = 30.0;
float wiltingPoint = 12.0;

float mean_moisture = 0;
float mean_flow = 0;
float total_time = 0;

String webMode = "auto";
String webMotor = "OFF";

float calibrationFactor = 1.0;
float noFlowThreshold = 0.3;

volatile int pulseCount = 0;

int moistureArray[15];
float flowArray[45];
float shortFlowArray[5];

int moistureIndex = 0;
int flowIndex = 0;
int shortFlowIndex = 0;

bool moistureReady = false;
bool flowReady = false;
bool shortFlowReady = false;

unsigned long lastSample = 0;
unsigned long cleanStart = 0;
bool cleaning = false;

unsigned long pausedTime = 0;
unsigned long pauseStartTime = 0;

unsigned long totalIrrigationTime = 0;
unsigned long lastTimeUpdate = 0;

bool clogRectifiedMsgActive = false;
unsigned long clogRectifiedMsgTimer = 0;

int lowFlowCounter = 0;
int overflowCounter = 0;

int cleanAttempts = 0;
int clogCount = 0;

bool overflowActive = false;
unsigned long overflowStartTime = 0;

int attempt = 1;
int attempt_no = 1;
bool irrigationActive = false;

unsigned long irrigationStart = 0;
unsigned long irrigationDuration = 0;

bool systemHalted = false;

float referenceFlow = 0;
bool referenceSet = false;
int validFlowSeconds = 0;

float lockedMoisture = 0;
bool moistureLocked = false;

float fixedIrrigationTime = 0;
bool timeFixed = false;

String message = "System Ready";
String lastMessage = "";

void updateMessage(String msg, float flow, float moist)
{
  String newMsg = msg + " | F:" + String(flow, 1) + " M:" + String(moist, 0);
  if (newMsg != lastMessage)
  {
    message = newMsg;
    lastMessage = newMsg;
  }
}

// ================= HISTORY LOGGING =================
void logHistory(String status)
{
  if (isFirebaseConnected)
  {
    FirebaseJson json;
    json.set("sprinklerId", SPRINKLER_ID);
    json.set("status", status);
    json.set("moisture", lockedMoisture > 0 ? lockedMoisture : mean_moisture);
    json.set("flow", referenceSet ? referenceFlow : mean_flow);
    json.set("time", total_time);

    // Use Firebase Server Timestamp
    FirebaseJson ts;
    ts.set(".sv", "timestamp");
    json.set("timestamp", ts);

    String histPath = "/users/" + uid + "/history";
    Firebase.RTDB.pushJSON(&fbdo, histPath, &json);
    Serial.println("Logged History: " + status);
  }
}

IRAM_ATTR void pulseCounter() { pulseCount++; }
float getMeanMoisture()
{
  long sum = 0;
  for (int i = 0; i < 15; i++)
    sum += moistureArray[i];
  return sum / 15.0;
}
float getMeanFlow()
{
  float sum = 0;
  for (int i = 0; i < 45; i++)
    sum += flowArray[i];
  return sum / 45.0;
}
float getShortMeanFlow()
{
  float sum = 0;
  for (int i = 0; i < 5; i++)
    sum += shortFlowArray[i];
  return sum / 5.0;
}

void sampleSensors()
{
  int m = analogRead(MOISTURE_PIN);
  moistureArray[moistureIndex++] = m;

  if (moistureIndex >= 15)
  {
    moistureIndex = 0;
    moistureReady = true;

    if (!moistureLocked)
    {
      lockedMoisture = getMeanMoisture();
      moistureLocked = true;
      mean_moisture = lockedMoisture;
    }
  }

  noInterrupts();
  int pulses = pulseCount;
  pulseCount = 0;
  interrupts();

  float currentFlow = (pulses / 7.5) * calibrationFactor;

  shortFlowArray[shortFlowIndex] = currentFlow;
  shortFlowIndex = (shortFlowIndex + 1) % 5;
  if (shortFlowIndex == 0)
    shortFlowReady = true;

  if (!moistureLocked)
    return;

  if (!referenceSet)
  {
    if (currentFlow < noFlowThreshold)
    {
      updateMessage("No flow STOP", currentFlow, lockedMoisture);
      irrigationActive = false;
      if (!systemHalted)
      {
        logHistory("Halted: No Flow Detected");
      }
      systemHalted = true;
      return;
    }
    else
    {
      validFlowSeconds++;
      if (flowIndex < 45)
      {
        flowArray[flowIndex++] = currentFlow;
      }

      if (validFlowSeconds == 15)
      {
        updateMessage("Flow stable, wait 30s", currentFlow, lockedMoisture);
      }
      else if (validFlowSeconds >= 45)
      {
        referenceFlow = getMeanFlow();
        referenceSet = true;
        mean_flow = referenceFlow;
        updateMessage("Ref Flow Set", referenceFlow, lockedMoisture);
      }
    }
  }
  else
  {
    if (!shortFlowReady)
      return;

    float meanF5s = getShortMeanFlow();
    float lowTh = referenceFlow * 0.8;
    float highTh = referenceFlow * 1.2;

    if (meanF5s < noFlowThreshold)
    {
      updateMessage("No flow STOP", meanF5s, lockedMoisture);
      irrigationActive = false;
      if (!systemHalted)
      {
        logHistory("Halted: No Flow Detected");
      }
      systemHalted = true;
      overflowActive = false;
      for (int i = 0; i < 45; i++)
        flowArray[i] = 0;
      return;
    }

    if (meanF5s < lowTh)
      lowFlowCounter++;
    else
      lowFlowCounter = 0;

    if (lowFlowCounter >= 15 && !cleaning)
    {
      clogCount++;

      if (cleanAttempts < 4)
      {
        updateMessage("Clog detected at", meanF5s, lockedMoisture);
        pauseStartTime = millis();
        digitalWrite(CLEAN_VALVE, HIGH);
        cleanStart = millis();
        cleaning = true;
        cleanAttempts++;
      }
      else
      {
        updateMessage("Clog not Rectified STOP", meanF5s, lockedMoisture);
        irrigationActive = false;
        if (!systemHalted)
        {
          logHistory("Halted: Clog Not Rectified");
        }
        systemHalted = true;
      }
      lowFlowCounter = 0;
    }

    if (meanF5s >= lowTh && cleanAttempts > 0)
    {
      updateMessage("Clog Rectified", meanF5s, lockedMoisture);
      cleanAttempts = 0;

      clogRectifiedMsgActive = true;
      clogRectifiedMsgTimer = millis();
    }

    if (meanF5s > highTh)
      overflowCounter++;
    else
      overflowCounter = 0;

    if (overflowCounter >= 15)
    {
      if (!overflowActive)
      {
        overflowActive = true;
        overflowStartTime = millis();
        updateMessage("Overflow detected", meanF5s, lockedMoisture);
      }
      overflowCounter = 0;
    }
  }
}

void handleCleaning()
{
  if (cleaning && millis() - cleanStart >= 5000)
  {
    digitalWrite(CLEAN_VALVE, LOW);
    cleaning = false;
    pausedTime += millis() - pauseStartTime;
  }
}

float calculateIrrigationTime(float flow, float moisture)
{
  float deficit = moisture - targetMoisture;
  if (deficit < 0)
    deficit = 0;
  float deficitRatio = deficit / 400.0;
  float soilFactor = (fieldCapacity - wiltingPoint) > 0
                         ? (fieldCapacity - wiltingPoint) * 0.1
                         : 2.2;

  float waterPerSqm = deficitRatio * soilFactor * rootDepth;
  float area = 3.1416 * radius * radius;
  float waterNeeded = area * waterPerSqm;
  if (flow <= 0.1)
    return 0;
  float irrigationTime = waterNeeded / flow;
  return irrigationTime;
}

// ================= EEPROM CONFIGURATION =================
void saveConfigToEEPROM()
{
  EEPROM.put(0, targetMoisture);
  EEPROM.put(4, rootDepth);
  EEPROM.put(8, fieldCapacity);
  EEPROM.put(12, wiltingPoint);
  EEPROM.write(16, 0x5A); // Magic byte to indicate valid saved data
  EEPROM.commit();
  Serial.println("Config saved to EEPROM");
}

void loadConfigFromEEPROM()
{
  if (EEPROM.read(16) == 0x5A)
  {
    EEPROM.get(0, targetMoisture);
    EEPROM.get(4, rootDepth);
    EEPROM.get(8, fieldCapacity);
    EEPROM.get(12, wiltingPoint);
    Serial.println("Config loaded from EEPROM");
  }
  else
  {
    Serial.println("No saved config found, using defaults");
  }
}

void streamCallback(FirebaseStream data)
{
  bool updated = false;
  if (data.dataType() == "json")
  {
    FirebaseJson *json = data.jsonObjectPtr();
    FirebaseJsonData result;
    if (json->get(result, "mode"))
      webMode = result.to<String>();
    if (json->get(result, "motor"))
      webMotor = result.to<String>();
    if (json->get(result, "thresholdMoisture"))
    {
      targetMoisture = result.to<float>();
      updated = true;
    }
    if (json->get(result, "rootDepth"))
    {
      rootDepth = result.to<float>();
      updated = true;
    }
    if (json->get(result, "fieldCapacity"))
    {
      fieldCapacity = result.to<float>();
      updated = true;
    }
    if (json->get(result, "wiltingPoint"))
    {
      wiltingPoint = result.to<float>();
      updated = true;
    }
  }
  else
  {
    String path = data.dataPath();
    if (path == "/mode")
      webMode = data.stringData();
    else if (path == "/motor")
      webMotor = data.stringData();
    else if (path == "/thresholdMoisture")
    {
      targetMoisture = data.floatData();
      updated = true;
    }
    else if (path == "/rootDepth")
    {
      rootDepth = data.floatData();
      updated = true;
    }
    else if (path == "/fieldCapacity")
    {
      fieldCapacity = data.floatData();
      updated = true;
    }
    else if (path == "/wiltingPoint")
    {
      wiltingPoint = data.floatData();
      updated = true;
    }
  }

  if (updated)
  {
    saveConfigToEEPROM();
  }
}
void streamTimeoutCallback(bool timeout)
{
  if (timeout)
    Serial.println("Stream timeout, resuming...");
}

void setup()
{
  Serial.begin(115200);

  // Initialize EEPROM
  EEPROM.begin(32);
  loadConfigFromEEPROM();

  // Force Auto Mode on boot so irrigation logic doesn't wait for "motor on"
  webMode = "auto";

  pinMode(FLOW_PIN, INPUT_PULLUP);
  pinMode(CLEAN_VALVE, OUTPUT);
  //  pinMode(MOTOR_PIN, OUTPUT);
  digitalWrite(CLEAN_VALVE, LOW);
  // digitalWrite(MOTOR_PIN, LOW);

  attachInterrupt(digitalPinToInterrupt(FLOW_PIN), pulseCounter, FALLING);

  // Start WiFi but DO NOT BLOCK! Let loop run while it connects
  WiFi.begin(WIFI_SSID, WIFI_PASS);
  Serial.println("Connecting to WiFi in background...");

  // BSSL Buffer size limits REMOVED because Google Identity Toolkit
  // requires > 1024 bytes for SSL certificates!

  config.api_key = API_KEY;
  config.database_url = DATABASE_URL;
  auth.user.email = USER_EMAIL;
  auth.user.password = USER_PASSWORD;
  config.token_status_callback = tokenStatusCallback;

  // Wait for WiFi before initializing Firebase to prevent SSL hangs
  Serial.print("Waiting for WiFi");
  while (WiFi.status() != WL_CONNECTED)
  {
    Serial.print(".");
    delay(500);
  }
  Serial.println();
  Serial.print("✅ WiFi Connected! IP Address for OTA: ");
  Serial.println(WiFi.localIP());

  Firebase.begin(&config, &auth);
  Firebase.reconnectWiFi(true);

  server.on("/", []()
            { server.send(200, "text/plain",
                          "Smart Irrigation Node Active. ID: " + String(SPRINKLER_ID)); });

  ElegantOTA.begin(&server);

  // CRITICAL: Stop Firebase during OTA to free up Heap Memory and prevent
  // crashes!
  ElegantOTA.onStart([]()
                     {
    Serial.println("OTA Update Started! Shutting down Firebase to free RAM.");
    Firebase.RTDB.endStream(&stream); });

  server.begin();
}

unsigned long lastFirebasePush = 0;

void loop()
{
  server.handleClient();
  ElegantOTA.loop();

  handleCleaning();

  if (WiFi.status() == WL_CONNECTED && Firebase.ready() &&
      !isFirebaseConnected)
  {
    isFirebaseConnected = true;
    uid = auth.token.uid.c_str();
    configPath = "/users/" + uid + "/config";
    sprinklerPath = "/users/" + uid + "/sprinklers/" + String(SPRINKLER_ID);

    Firebase.RTDB.setString(&fbdo, sprinklerPath + "/ip",
                            WiFi.localIP().toString());

    if (!Firebase.RTDB.beginStream(&stream, configPath))
    {
      Serial.println("Stream begin error: " + stream.errorReason());
    }
    Firebase.RTDB.setStreamCallback(&stream, streamCallback,
                                    streamTimeoutCallback);
  }

  if (millis() - lastSample >= 1000)
  {
    lastSample = millis();
    sampleSensors();

    if (isFirebaseConnected && (millis() - lastFirebasePush > 2000))
    {
      lastFirebasePush = millis();

      FirebaseJson json;

      // Add server timestamp for offline detection heartbeat
      FirebaseJson ts;
      ts.set(".sv", "timestamp");
      json.set("lastUpdated", ts);

      json.set("moisture", lockedMoisture > 0 ? lockedMoisture : mean_moisture);
      json.set("flow", referenceSet ? referenceFlow : mean_flow);
      json.set("time", total_time);

      if (webMode == "manual" && webMotor == "OFF")
      {
        json.set("message", "System Idle (Manual Override)");
      }
      else
      {
        json.set("message", message);
      }

      Firebase.RTDB.updateNode(&fbdo, sprinklerPath, &json);
    }
  }

  // --- MANUAL MODE OVERRIDE ---
  if (webMode == "manual")
  {
    irrigationActive = (webMotor == "ON");
    if (!irrigationActive)
    {
      systemHalted = false;
      moistureLocked = false;
      referenceSet = false;
      timeFixed = false;
      attempt = 1;
      totalIrrigationTime = 0;
      total_time = 0;
    }
  }
  else // --- AUTO MODE LOGIC ---
  {
    if (clogRectifiedMsgActive && millis() - clogRectifiedMsgTimer >= 10000)
    {
      clogRectifiedMsgActive = false;
      if (irrigationActive && !cleaning && !systemHalted && !overflowActive &&
          cleanAttempts == 0)
      {
        updateMessage("Irrigation ongoing", referenceFlow, lockedMoisture);
      }
    }

    if (moistureLocked && lockedMoisture <= targetMoisture)
    {
      updateMessage("Soil wet. Standby.", 0, lockedMoisture);

      if (attempt > 1 || total_time > 0)
      {
        logHistory("Completed: Soil Wet");
      }

      moistureLocked = false;
      moistureIndex = 0;
      referenceSet = false;
      validFlowSeconds = 0;
      flowIndex = 0;
      attempt = 1;
      attempt_no = attempt;
      irrigationActive = false;
      for (int i = 0; i < 45; i++)
        flowArray[i] = 0;
    }

    if (systemHalted)
    {
      digitalWrite(CLEAN_VALVE, LOW);
    }

    if (moistureLocked && referenceSet && !systemHalted)
    {
      if (overflowActive)
      {
        if (getShortMeanFlow() < referenceFlow * 1.2)
        {
          overflowActive = false;
          updateMessage("Overflow cleared", getShortMeanFlow(), lockedMoisture);

          if (irrigationActive && !cleaning && !systemHalted)
          {
            updateMessage("Irrigation ongoing", referenceFlow, lockedMoisture);
          }
        }
        else if (millis() - overflowStartTime >= 30000)
        {
          updateMessage("Overflow STOP", getShortMeanFlow(), lockedMoisture);
          irrigationActive = false;
          if (!systemHalted)
          {
            logHistory("Halted: Overflow");
          }
          systemHalted = true;
        }
      }

      if (irrigationActive && !cleaning)
      {
        if (millis() - lastTimeUpdate >= 1000)
        {
          totalIrrigationTime += 1000;
          lastTimeUpdate = millis();
        }
      }

      if (!irrigationActive && !systemHalted &&
          lockedMoisture > targetMoisture)
      {
        totalIrrigationTime = 0;
        attempt_no = attempt;

        if (!timeFixed)
        {
          fixedIrrigationTime =
              calculateIrrigationTime(referenceFlow, lockedMoisture);
          total_time = fixedIrrigationTime;
          timeFixed = true;
        }

        irrigationDuration = (unsigned long)(fixedIrrigationTime * 60000UL);

        updateMessage("Irrigation Attempt " + String(attempt) + " ongoing",
                      referenceFlow, lockedMoisture);

        irrigationActive = true;
        irrigationStart = millis();
        lastTimeUpdate = millis();
      }

      if (irrigationActive &&
          millis() - irrigationStart - pausedTime >= irrigationDuration)
      {
        if (attempt >= 4)
        {
          updateMessage("Target not reached STOP", referenceFlow,
                        lockedMoisture);
          irrigationActive = false;
          if (!systemHalted)
          {
            logHistory("Failed: Target not reached");
          }
          systemHalted = true;
        }
        else
        {
          updateMessage("Attempt " + String(attempt) + " done. Remeasuring...",
                        referenceFlow, lockedMoisture);
          irrigationActive = false;
          attempt++;
          attempt_no = attempt;
          moistureLocked = false;
          moistureIndex = 0;
          referenceSet = false;
          timeFixed = false;
          validFlowSeconds = 0;
          flowIndex = 0;
          pausedTime = 0;
        }
      }
    }
  }

  //-- -ACTUATOR CONTROL REMOVED-- -
  // Physical motor control has been removed as per user request.
  // The system acts purely as a sensor node to send logic to the cloud.
  // it may included in future if user wants to control motor from node itself.
  // in developing stage, the motor control code was removed to avoid any accidental activation of the irrigation system during testing and development. The system now focuses on monitoring soil moisture and flow rates, sending this data to the cloud for further analysis and decision-making.
}